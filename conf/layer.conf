## conf/layer.conf
```bitbake
# We have a conf and classes directory, add to BBPATH
BBPATH .= ":${LAYERDIR}"

# We have recipes-* directories, add to BBFILES
BBFILES += "${LAYERDIR}/recipes-*/*/*.bb \
	${LAYERDIR}/recipes-*/*/*.bbappend"

BBFILE_COLLECTIONS += "meta-mbed-raspberrypi"
BBFILE_PATTERN_meta-mbed-raspberrypi = "^${LAYERDIR}/"
BBFILE_PRIORITY_meta-mbed-raspberrypi = "6"
LAYERSERIES_COMPAT_meta-mbed-raspberrypi = "sumo"
```

## conf/machine/mbed-rpi3.conf
```bitbake
#@TYPE: Machine
#@NAME: Mbed machine based on RPi 3
#@DESCRIPTION: Machine configuration for the Mbed

#Were building on RPi3, so for the convenience, set the machine variable and include its conf
MACHINE = "raspberrypi3"
include conf/machine/raspberrypi3.conf

KERNEL_INITRAMFS = ""

#Use our custom scard_image-class in addition to the regular Raspberry Pi sdcard_image
IMAGE_CLASSES += " mbed_sdcard_image-rpi "
IMAGE_FSTYPES += " mbed-sdimg "
```
